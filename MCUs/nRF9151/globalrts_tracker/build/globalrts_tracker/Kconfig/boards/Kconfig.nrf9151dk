## MCUs/nRF9151/globalrts_tracker/build/globalrts_tracker/Kconfig/boards/Kconfig.nrf9151dk
```kconfig
# Load board Kconfig descriptions.
osource "C:/ncs/v3.2.1/zephyr/boards/nordic/nrf9151dk/Kconfig.nrf9151dk"
```
